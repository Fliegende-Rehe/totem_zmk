## config/west.yml
```yaml
manifest:
  remotes:
    - name: zmkfirmware
      url-base: https://github.com/zmkfirmware

    - name: Fliegende-Rehe                           
      url-base: https://github.com/Fliegende-Rehe

  projects:
    - name: zmk
      remote: zmkfirmware
      revision: main
      import: app/west.yml

    - name: prospector-zmk-module                
      remote: Fliegende-Rehe                          
      revision: main    
      
  self:
    path: config
```
